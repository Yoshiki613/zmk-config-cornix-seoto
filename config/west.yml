## config/west.yml
```yaml
manifest:
  remotes:
    - name: zmkfirmware
      url-base: https://github.com/zmkfirmware
    - name: hitsmaxft
      url-base: https://github.com/hitsmaxft

  projects:
    - name: zmk
      remote: zmkfirmware
      revision: v0.3.0
      clone-depth: 1
      import:
        file: app/west.yml

    - name: zmk-keyboard-cornix
      remote: hitsmaxft
      revision: v2.6.8
      clone-depth: 1

  self:
    path: config
```
